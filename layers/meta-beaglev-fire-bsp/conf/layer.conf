## layers/meta-beaglev-fire-bsp/conf/layer.conf
```bitbake
# We have a conf and classes directory, add to BBPATH
BBPATH .= ":${LAYERDIR}"

# We have recipes-* directories, add to BBFILES
BBFILES += "${LAYERDIR}/recipes-*/*/*.bb \
            ${LAYERDIR}/recipes-*/*/*.bbappend"

BBFILE_COLLECTIONS += "meta-beaglev-fire-bsp"
BBFILE_PATTERN_meta-beaglev-fire-bsp = "^${LAYERDIR}/"
BBFILE_PRIORITY_meta-beaglev-fire-bsp = "6"

LAYERDEPENDS_meta-beaglev-fire-bsp = "core"
LAYERSERIES_COMPAT_meta-beaglev-fire-bsp = "scarthgap"
```

## layers/meta-beaglev-fire-bsp/wic/beaglev-fire-rauc.wks
```
part /boot --source bootimg-partition --fstype=vfat --label boot --active --align 4096 --size 128M
part / --source rootfs --fstype=ext4 --label rootfs.0 --align 4096 --size 4G
part --source rootfs --fstype=ext4 --label rootfs.1 --align 4096 --size 4G
part /data --fstype=ext4 --label data --align 4096 --size 1G
```

## layers/meta-spaceros-app/conf/layer.conf
```bitbake
# We have a conf and classes directory, add to BBPATH
BBPATH .= ":${LAYERDIR}"

# We have recipes-* directories, add to BBFILES
BBFILES += "${LAYERDIR}/recipes-*/*/*.bb \
            ${LAYERDIR}/recipes-*/*/*.bbappend"

BBFILE_COLLECTIONS += "meta-spaceros-app"
BBFILE_PATTERN_meta-spaceros-app = "^${LAYERDIR}/"
BBFILE_PRIORITY_meta-spaceros-app = "6"

LAYERDEPENDS_meta-spaceros-app = "core"
LAYERSERIES_COMPAT_meta-spaceros-app = "scarthgap"
```

## layers/meta-spaceros-distro/conf/layer.conf
```bitbake
# We have a conf and classes directory, add to BBPATH
BBPATH .= ":${LAYERDIR}"

# We have recipes-* directories, add to BBFILES
BBFILES += "${LAYERDIR}/recipes-*/*/*.bb \
            ${LAYERDIR}/recipes-*/*/*.bbappend"

BBFILE_COLLECTIONS += "meta-spaceros-distro"
BBFILE_PATTERN_meta-spaceros-distro = "^${LAYERDIR}/"
BBFILE_PRIORITY_meta-spaceros-distro = "6"

LAYERDEPENDS_meta-spaceros-distro = "core"
LAYERSERIES_COMPAT_meta-spaceros-distro = "scarthgap"
```
